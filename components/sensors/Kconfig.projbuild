## components/sensors/Kconfig.projbuild
```kconfig
menu "LDM Sensors"

# DHT11 Configuration
    config DHT_SENSOR_ENABLED
        bool "Enable DHT Temperature/Humidity Sensor"
        default False
        help
            Enable DHT Sensor.

    menu "DHT Sensor Configuration"
    depends on DHT_SENSOR_ENABLED

        config DHT_GPIO
            int "DHT GPIO Pin"
            default 4
            help
                GPIO Pin to read the DHT11 sensor.

        choice DHT_TYPE
            prompt "DHT Sensor Type"
            default DHT_TYPE_DHT11
            help
                DHT Sensor Type.

            config DHT_TYPE_DHT11
                bool "DHT11"
            config DHT_TYPE_DHT22
                bool "DHT22"
        endchoice

    endmenu
# End DHT11 Configuration

# BME680 Configuration
    config BME680_SENSOR_ENABLED
        bool "Enable BME680 Temperature/Humidity/Pressure/Gas Sensor"
        default False
        help
            Enable BME680 Sensor.

    menu "BME680 Configuration"
    depends on BME680_SENSOR_ENABLED
        config I2C_SCL
            int "I2C SCL GPIO Pin"
            default 19
            help
                SCL Pin to read I2C.

        config I2C_SDA
            int "I2C SDA GPIO Pin"
            default 18
            help
                SDA Pin to read I2C.

        config I2C_PORT
            int "I2C PORT"
            default 0
            help
                Port to read I2C.

    endmenu
# End BME680 Configuration

endmenu
```

## sdkconfig.defaults
```kconfig
# Use lower CPU frequency
CONFIG_ESP32_DEFAULT_CPU_FREQ_80=y
# Enable support for power management
CONFIG_PM_ENABLE=y
# Enable tickless idle mode
CONFIG_FREERTOS_USE_TICKLESS_IDLE=y
# Use RTC timer as reference
CONFIG_PM_USE_RTC_TIMER_REF=y
# Set default flashsize
CONFIG_ESPTOOLPY_FLASHSIZE_4MB=y
CONFIG_ESPTOOLPY_FLASHSIZE="4MB"
CONFIG_ESPTOOLPY_FLASHSIZE_DETECT=y

##
## Partition Table
##
## CONFIG_PARTITION_TABLE_SINGLE_APP is not set
## CONFIG_PARTITION_TABLE_TWO_OTA is not set
#CONFIG_PARTITION_TABLE_CUSTOM=y
#CONFIG_PARTITION_TABLE_CUSTOM_FILENAME="partitions.csv"
#CONFIG_PARTITION_TABLE_FILENAME="partitions.csv"
#CONFIG_PARTITION_TABLE_OFFSET=0x8000
#CONFIG_PARTITION_TABLE_MD5=y
## end of Partition Table

# Enable Bluetooth Controller
CONFIG_BTDM_CTRL_MODE_BLE_ONLY=y
CONFIG_BTDM_CTRL_PINNED_TO_CORE=0

# Enable Bluetooth Modem Sleep
CONFIG_BTDM_MODEM_SLEEP=y
CONFIG_BTDM_MODEM_SLEEP_MODE_ORIG=y
CONFIG_BTDM_LPCLK_SEL_MAIN_XTAL=y

# Enable Bluetooth/BLE
CONFIG_BT_ENABLED=y
CONFIG_BT_BLUEDROID_ENABLED=y
CONFIG_BT_BLE_ENABLED=y
CONFIG_BT_GATTS_ENABLE=y

CONFIG_BT_CLASSIC_ENABLED=y
CONFIG_BT_SPP_ENABLED=y 
```
